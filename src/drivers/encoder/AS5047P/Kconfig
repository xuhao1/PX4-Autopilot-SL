## src/drivers/encoder/AS5047P/Kconfig
```kconfig
menuconfig DRIVERS_ENCODER_AS5047P
	bool "as5047p"
	default n
	---help---
		Enable support for as5047p
```

## src/drivers/encoder/Kconfig
```kconfig
menu "Encoders"
    menuconfig COMMON_Encoders
        bool "Encoder sensors"
        default n
        select DRIVERS_ENCODER_ECODER
        select DRIVERS_ENCODER_AS5047P
        ---help---
            Enable default set of hygrometer sensors
    rsource "*/Kconfig"
endmenu #Encoders
```

## src/drivers/encoder/ecoder/Kconfig
```kconfig
menuconfig DRIVERS_ENCODER_ECODER
	bool "ecoder"
	default n
	---help---
		Enable support for ecoder
```

## src/modules/swashplateless_mixer/Kconfig
```kconfig
menuconfig MODULES_SWASHPLATELESS_MIXER
	bool "swashplateless_mixer"
	default n
	---help---
		Enable support for swashplateless_mixer
```
